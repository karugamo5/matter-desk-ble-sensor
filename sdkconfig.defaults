## sdkconfig.defaults
```kconfig
CONFIG_ENABLE_CHIPOBLE=y
CONFIG_USE_BLE_ONLY_FOR_COMMISSIONING=n
CONFIG_BT_ENABLED=y
CONFIG_BT_NIMBLE_ENABLED=y
CONFIG_MBEDTLS_HKDF_C=y
CONFIG_ESPTOOLPY_FLASHSIZE_8MB=y
CONFIG_ESPTOOLPY_FLASHSIZE="8MB"
CONFIG_PARTITION_TABLE_CUSTOM=y
CONFIG_PARTITION_TABLE_CUSTOM_FILENAME="partitions_matter_8mb.csv"
```
